## packages/embedded/esp32h2-qemu/hello-world/sdkconfig.defaults
```kconfig
# ESP32-H2 (M5NanoH2) SDK Configuration Defaults
#
# Target: ESP32-H2 (RISC-V single-core @ 96MHz)
# Board: M5NanoH2

# ============================================================================
# Target Selection
# ============================================================================
CONFIG_IDF_TARGET="esp32h2"

# ============================================================================
# Flash Configuration
# ============================================================================
# M5NanoH2 has 4MB flash
CONFIG_ESPTOOLPY_FLASHSIZE_4MB=y
CONFIG_ESPTOOLPY_FLASHMODE_DIO=y
CONFIG_ESPTOOLPY_FLASHFREQ_48M=y

# ============================================================================
# CPU / Clock Configuration
# ============================================================================
# ESP32-H2 runs at 96MHz max (not 240MHz like S3!)
CONFIG_ESP_DEFAULT_CPU_FREQ_MHZ_96=y

# ============================================================================
# Serial / UART Configuration
# ============================================================================
CONFIG_ESP_CONSOLE_UART_DEFAULT=y
CONFIG_ESP_CONSOLE_UART_BAUDRATE=115200

# ============================================================================
# Logging
# ============================================================================
CONFIG_LOG_DEFAULT_LEVEL_INFO=y
CONFIG_LOG_COLORS=y

# ============================================================================
# FreeRTOS Configuration
# ============================================================================
CONFIG_FREERTOS_HZ=1000

# ============================================================================
# IEEE 802.15.4 (Zigbee/Thread/Matter)
# ============================================================================
# ESP32-H2's main wireless feature - enable radio
CONFIG_IEEE802154_ENABLED=y

# ============================================================================
# Bluetooth LE 5.0
# ============================================================================
CONFIG_BT_ENABLED=y
CONFIG_BT_NIMBLE_ENABLED=y

# ============================================================================
# WiFi — DISABLED (ESP32-H2 has NO WiFi!)
# ============================================================================
# CONFIG_ESP_WIFI_ENABLED is not set

# ============================================================================
# Watchdog
# ============================================================================
CONFIG_ESP_TASK_WDT_TIMEOUT_S=10

# ============================================================================
# GPIO Configuration for M5NanoH2
# ============================================================================
# Note: GPIO assignments are in code, not sdkconfig
# G3  = IR TX
# G4  = Blue LED
# G9  = Button (boot strapping)
# G10 = RGB Power Enable
# G11 = RGB Data (WS2812)
# G1  = Grove White
# G2  = Grove Yellow
```
